## CMakeLists.txt
```
cmake_minimum_required(VERSION 3.20.0)

find_package(Zephyr REQUIRED HINTS $ENV{ZEPHYR_BASE})
project(secure_mass)

target_sources(app PRIVATE
	src/main.c
	src/secure_mass_button.c
	src/secure_mass_hid.c
	src/secure_mass_indicator.c
	src/secure_mass_msc.c
	src/secure_mass_usb.c
)
```

## Kconfig
```
# Copyright (c) 2026
# SPDX-License-Identifier: Apache-2.0

config APP_SECURE_MASS
	bool
	default y
	select USB_DEVICE_HID_COMMON
	select USB_DEVICE_MSC_BOT

menu "Secure mass sample options"

choice APP_SECURE_MASS_REENUM_STRATEGY
	prompt "USB re-enumeration strategy"
	default APP_SECURE_MASS_REENUM_SOFT_REBOOT
	help
	  Select how the sample switches between the locked HID-only and
	  unlocked HID+MSC USB personas.

config APP_SECURE_MASS_REENUM_SOFT_REBOOT
	bool "Warm reboot into the target USB mode"
	select REBOOT
	help
	  Store the target USB mode in retained RAM and warm reboot. This is
	  the most reliable option on boards where usb_disable() does not
	  create a host-visible disconnect.

config APP_SECURE_MASS_REENUM_USB_DISABLE_ENABLE
	bool "Switch modes with usb_disable()/usb_enable()"
	help
	  Reconfigure the legacy USB device stack in place by detaching,
	  changing descriptors, and enabling USB again. This depends on the
	  board and USB driver providing a host-visible disconnect.

endchoice

config APP_SECURE_MASS_USER_BUTTON_UNLOCK
	bool "Enable unlock via board user button"
	default y
	select GPIO
	help
	  Allow the board's user button (for example DT alias sw0 on
	  stm32f4_disco) to request an unlock transition.

config APP_SECURE_MASS_LOCK_STATUS_INDICATOR
	bool "Enable lock status LED indicator"
	default y
	select GPIO
	help
	  Drive board LEDs to show lock state. The secure_mass sample uses
	  red for locked and green for unlocked on stm32f4_disco.

endmenu

source "Kconfig.zephyr"
```

## prj.conf
```kconfig
CONFIG_STDOUT_CONSOLE=y

CONFIG_LOG=y
CONFIG_USB_DEVICE_STACK=y
CONFIG_USB_DEVICE_INITIALIZE_AT_BOOT=n
# CONFIG_USB_DEVICE_VID=0x1234
# CONFIG_USB_DEVICE_PID=0x2001
CONFIG_USB_DEVICE_MANUFACTURER="Zephyr"
CONFIG_USB_DEVICE_PRODUCT="Secure USB Mass"
CONFIG_USB_DEVICE_SN="0011223344556677"
CONFIG_USB_DEVICE_LOG_LEVEL_ERR=y
CONFIG_USB_DRIVER_LOG_LEVEL_ERR=y
CONFIG_USB_REQUEST_BUFFER_SIZE=128

CONFIG_GPIO=y
CONFIG_DISK_ACCESS=y
CONFIG_DISK_DRIVER_RAM=y

CONFIG_MAIN_STACK_SIZE=4096
```

## src/main.c
```c
/*
 * Copyright (c) 2026
 *
 * SPDX-License-Identifier: Apache-2.0
 */

#include <zephyr/logging/log.h>

#include "secure_mass_priv.h"

LOG_MODULE_REGISTER(secure_mass, LOG_LEVEL_INF);

int main(void)
{
	int ret;

	ret = secure_msc_init();
	if (ret != 0) {
		return ret;
	}

	ret = secure_mass_button_init();
	if (ret != 0) {
		return ret;
	}

	ret = secure_mass_indicator_init();
	if (ret != 0) {
		return ret;
	}

	ret = secure_mass_usb_init_locked();
	if (ret != 0) {
		return ret;
	}

	LOG_INF("secure_mass ready");

	secure_hid_process_loop();
	return 0;
}
```

## src/secure_mass_button.c
```c
/*
 * Copyright (c) 2026
 *
 * SPDX-License-Identifier: Apache-2.0
 */

#if defined(CONFIG_APP_SECURE_MASS_USER_BUTTON_UNLOCK)

#include <zephyr/drivers/gpio.h>
#include <zephyr/kernel.h>
#include <zephyr/logging/log.h>

#include "secure_mass_priv.h"

LOG_MODULE_DECLARE(secure_mass, LOG_LEVEL_INF);

static const struct gpio_dt_spec unlock_button =
	GPIO_DT_SPEC_GET_OR(DT_ALIAS(sw0), gpios, {0});
static struct gpio_callback unlock_button_cb_data;

static void secure_mass_button_work_handler(struct k_work *work);
static void secure_mass_button_pressed(const struct device *port,
				       struct gpio_callback *cb,
				       gpio_port_pins_t pins);

static K_WORK_DEFINE(unlock_button_work, secure_mass_button_work_handler);

static void secure_mass_button_work_handler(struct k_work *work)
{
	int ret;

	ARG_UNUSED(work);

	ret = secure_mass_request_unlock();
	if (ret == 0) {
		LOG_INF("Unlock requested by user button");
	} else if (ret != -EBUSY && ret != -EALREADY) {
		LOG_WRN("Button unlock request failed (%d)", ret);
	}
}

static void secure_mass_button_pressed(const struct device *port,
				       struct gpio_callback *cb,
				       gpio_port_pins_t pins)
{
	ARG_UNUSED(port);
	ARG_UNUSED(cb);
	ARG_UNUSED(pins);

	k_work_submit(&unlock_button_work);
}

int secure_mass_button_init(void)
{
	int ret;

	if (!unlock_button.port) {
		return 0;
	}

	if (!gpio_is_ready_dt(&unlock_button)) {
		LOG_ERR("Button device %s is not ready", unlock_button.port->name);
		return -ENODEV;
	}

	ret = gpio_pin_configure_dt(&unlock_button, GPIO_INPUT);
	if (ret != 0) {
		LOG_ERR("Failed to configure unlock button (%d)", ret);
		return ret;
	}

	ret = gpio_pin_interrupt_configure_dt(&unlock_button,
					      GPIO_INT_EDGE_TO_ACTIVE);
	if (ret != 0) {
		LOG_ERR("Failed to enable unlock button interrupt (%d)", ret);
		return ret;
	}

	gpio_init_callback(&unlock_button_cb_data, secure_mass_button_pressed,
			   BIT(unlock_button.pin));
	ret = gpio_add_callback(unlock_button.port, &unlock_button_cb_data);
	if (ret != 0) {
		LOG_ERR("Failed to register unlock button callback (%d)", ret);
		return ret;
	}

	return 0;
}

#else

#include "secure_mass_priv.h"

int secure_mass_button_init(void)
{
	return 0;
}

#endif
```

## src/secure_mass_hid.c
```c
/*
 * Copyright (c) 2026
 *
 * SPDX-License-Identifier: Apache-2.0
 */

#include <string.h>

#include <zephyr/logging/log.h>

#include "secure_mass_priv.h"

LOG_MODULE_DECLARE(secure_mass, LOG_LEVEL_INF);

static const uint8_t secure_hid_report_desc[] = {
	0x06, 0x00, 0xFF,
	0x09, 0x01,
	0xA1, 0x01,
	0x09, 0x02,
	0x15, 0x00,
	0x26, 0xFF, 0x00,
	0x75, 0x08,
	0x95, SECURE_HID_PKT_LEN,
	0x81, 0x02,
	0x09, 0x03,
	0x15, 0x00,
	0x26, 0xFF, 0x00,
	0x75, 0x08,
	0x95, SECURE_HID_PKT_LEN,
	0x91, 0x02,
	0xC0,
};

BUILD_ASSERT(sizeof(secure_hid_report_desc) == SECURE_HID_REPORT_DESC_SIZE,
	     "secure HID report descriptor size changed");

K_MSGQ_DEFINE(hid_rx_msgq, sizeof(struct hid_rx_msg), 8, 4);

static void queue_hid_packet(const uint8_t *buf, size_t len);
static int secure_hid_send_packet(const struct hid_pkt_v1 *pkt);
static void send_hid_response(uint8_t cmd, uint8_t seq, uint8_t status,
			      const uint8_t *payload, size_t len);
static uint8_t get_info_flags(void);
static void handle_get_info(const struct hid_pkt_v1 *req);
static void handle_unlock(const struct hid_pkt_v1 *req);
static void handle_change_password(const struct hid_pkt_v1 *req);
static void handle_hid_request(const struct hid_pkt_v1 *req);
static int secure_hid_get_idle(void *context, struct usb_setup_packet *setup,
			       int32_t *len, uint8_t **data);
static int secure_hid_get_report(void *context, struct usb_setup_packet *setup,
				 int32_t *len, uint8_t **data);
static int secure_hid_get_protocol(void *context,
				   struct usb_setup_packet *setup,
				   int32_t *len, uint8_t **data);
static int secure_hid_set_idle(void *context, struct usb_setup_packet *setup,
			       int32_t *len, uint8_t **data);
static int secure_hid_set_report(void *context, struct usb_setup_packet *setup,
				 int32_t *len, uint8_t **data);
static int secure_hid_set_protocol(void *context,
				   struct usb_setup_packet *setup,
				   int32_t *len, uint8_t **data);
static void secure_hid_int_in(uint8_t ep,
			      enum usb_dc_ep_cb_status_code ep_status);
static void secure_hid_int_out(uint8_t ep,
			       enum usb_dc_ep_cb_status_code ep_status);

struct usb_ep_cfg_data secure_hid_ep_data[SECURE_HID_NUM_ENDPOINTS] = {
	{
		.ep_cb = secure_hid_int_in,
		.ep_addr = SECURE_HID_IN_EP_ADDR,
	},
	{
		.ep_cb = secure_hid_int_out,
		.ep_addr = SECURE_HID_OUT_EP_ADDR,
	},
};

static const struct usb_hid_req_handlers secure_hid_req_handlers = {
	.get_idle = secure_hid_get_idle,
	.get_report = secure_hid_get_report,
	.get_protocol = secure_hid_get_protocol,
	.set_idle = secure_hid_set_idle,
	.set_report = secure_hid_set_report,
	.set_protocol = secure_hid_set_protocol,
};

static void queue_hid_packet(const uint8_t *buf, size_t len)
{
	struct hid_rx_msg msg;

	if (len > SECURE_HID_PKT_LEN) {
		return;
	}

	memset(&msg, 0, sizeof(msg));
	msg.len = len;
	memcpy(msg.data, buf, len);

	if (k_msgq_put(&hid_rx_msgq, &msg, K_NO_WAIT) != 0) {
		LOG_WRN("Dropping HID packet: queue full");
	}
}

static int secure_hid_send_packet(const struct hid_pkt_v1 *pkt)
{
	int ret;

	if (!secure_mass_runtime.hid_configured) {
		return -EAGAIN;
	}

	if (atomic_test_and_set_bit(secure_mass_runtime.hid_flags, HID_EP_BUSY_FLAG)) {
		return -EBUSY;
	}

	ret = usb_write(SECURE_HID_IN_EP_ADDR, (const uint8_t *)pkt,
			sizeof(*pkt), NULL);
	if (ret != 0) {
		atomic_clear_bit(secure_mass_runtime.hid_flags, HID_EP_BUSY_FLAG);
	}

	return ret;
}

static void send_hid_response(uint8_t cmd, uint8_t seq, uint8_t status,
			      const uint8_t *payload, size_t len)
{
	struct hid_pkt_v1 rsp;
	int ret;

	memset(&rsp, 0, sizeof(rsp));
	rsp.version = 1;
	rsp.cmd = cmd | BIT(7);
	rsp.seq = seq;
	rsp.status = status;
	rsp.len = MIN(len, sizeof(rsp.data));
	if (payload != NULL && rsp.len > 0) {
		memcpy(rsp.data, payload, rsp.len);
	}

	ret = secure_hid_send_packet(&rsp);
	if (ret != 0) {
		LOG_WRN("Failed to send HID response (%d)", ret);
	}
}

static uint8_t get_info_flags(void)
{
	uint8_t flags = 0U;

	if (secure_mass_runtime.current_password_len > 0U) {
		flags |= BIT(0);
	}
	if (secure_mass_runtime.state == SECURE_STATE_UNLOCKED) {
		flags |= BIT(1);
		flags |= BIT(2);
	}

	return flags;
}

static void handle_get_info(const struct hid_pkt_v1 *req)
{
	uint8_t payload[5];

	payload[0] = secure_mass_runtime.state;
	payload[1] = SECURE_PASSWORD_MAX_LEN;
	payload[2] = get_info_flags();
	payload[3] = 0xFF;
	payload[4] = 0;

	send_hid_response(req->cmd, req->seq, SECURE_STATUS_OK,
			  payload, sizeof(payload));
}

static void handle_unlock(const struct hid_pkt_v1 *req)
{
	size_t password_len;

	if (secure_mass_is_transition_state()) {
		send_hid_response(req->cmd, req->seq, SECURE_STATUS_BUSY, NULL, 0);
		return;
	}

	if (secure_mass_runtime.state != SECURE_STATE_LOCKED) {
		send_hid_response(req->cmd, req->seq, SECURE_STATUS_INVALID_STATE,
				  NULL, 0);
		return;
	}

	if (req->len < 1U) {
		send_hid_response(req->cmd, req->seq, SECURE_STATUS_BAD_LENGTH,
				  NULL, 0);
		return;
	}

	password_len = req->data[0];
	if (password_len > SECURE_PASSWORD_MAX_LEN ||
	    req->len != (password_len + 1U)) {
		send_hid_response(req->cmd, req->seq, SECURE_STATUS_BAD_LENGTH,
				  NULL, 0);
		return;
	}

	if (password_len != secure_mass_runtime.current_password_len ||
	    memcmp(&req->data[1], secure_mass_runtime.current_password,
		   password_len) != 0) {
		send_hid_response(req->cmd, req->seq, SECURE_STATUS_BAD_PASSWORD,
				  NULL, 0);
		return;
	}

	if (secure_mass_request_unlock() != 0) {
		send_hid_response(req->cmd, req->seq,
				  SECURE_STATUS_INTERNAL_ERROR, NULL, 0);
		return;
	}

	send_hid_response(req->cmd, req->seq, SECURE_STATUS_OK, NULL, 0);
}

static void handle_change_password(const struct hid_pkt_v1 *req)
{
	size_t new_len;

	if (secure_mass_is_transition_state()) {
		send_hid_response(req->cmd, req->seq, SECURE_STATUS_BUSY, NULL, 0);
		return;
	}

	if (secure_mass_runtime.state != SECURE_STATE_UNLOCKED) {
		send_hid_response(req->cmd, req->seq, SECURE_STATUS_INVALID_STATE,
				  NULL, 0);
		return;
	}

	if (req->len < 1U) {
		send_hid_response(req->cmd, req->seq, SECURE_STATUS_BAD_LENGTH,
				  NULL, 0);
		return;
	}

	new_len = req->data[0];
	if (new_len > SECURE_PASSWORD_MAX_LEN ||
	    req->len != (new_len + 1U)) {
		send_hid_response(req->cmd, req->seq, SECURE_STATUS_BAD_LENGTH,
				  NULL, 0);
		return;
	}

	memset(secure_mass_runtime.current_password, 0,
	       sizeof(secure_mass_runtime.current_password));
	memcpy(secure_mass_runtime.current_password, &req->data[1], new_len);
	secure_mass_runtime.current_password_len = new_len;

	send_hid_response(req->cmd, req->seq, SECURE_STATUS_OK, NULL, 0);
}

static void handle_hid_request(const struct hid_pkt_v1 *req)
{
	if (req->version != 1U || req->len > sizeof(req->data)) {
		send_hid_response(req->cmd, req->seq, SECURE_STATUS_BAD_LENGTH,
				  NULL, 0);
		return;
	}

	switch (req->cmd) {
	case SECURE_CMD_GET_INFO:
		if (req->len != 0U) {
			send_hid_response(req->cmd, req->seq, SECURE_STATUS_BAD_LENGTH,
					  NULL, 0);
			return;
		}
		handle_get_info(req);
		break;
	case SECURE_CMD_UNLOCK:
		handle_unlock(req);
		break;
	case SECURE_CMD_CHANGE_PASSWORD:
		handle_change_password(req);
		break;
	default:
		send_hid_response(req->cmd, req->seq, SECURE_STATUS_NOT_SUPPORTED,
				  NULL, 0);
		break;
	}
}

static int secure_hid_get_idle(void *context, struct usb_setup_packet *setup,
			       int32_t *len, uint8_t **data)
{
	ARG_UNUSED(context);
	ARG_UNUSED(setup);

	*data = &secure_mass_runtime.hid_idle_rate;
	*len = 1;
	return 0;
}

static int secure_hid_get_report(void *context, struct usb_setup_packet *setup,
				 int32_t *len, uint8_t **data)
{
	static uint8_t zero_report[SECURE_HID_PKT_LEN];

	ARG_UNUSED(context);

	*data = zero_report;
	*len = MIN(setup->wLength, sizeof(zero_report));
	return 0;
}

static int secure_hid_get_protocol(void *context,
				   struct usb_setup_packet *setup,
				   int32_t *len, uint8_t **data)
{
	ARG_UNUSED(context);
	ARG_UNUSED(setup);

	*data = &secure_mass_runtime.hid_protocol;
	*len = 1;
	return 0;
}

static int secure_hid_set_idle(void *context, struct usb_setup_packet *setup,
			       int32_t *len, uint8_t **data)
{
	ARG_UNUSED(context);
	ARG_UNUSED(len);
	ARG_UNUSED(data);

	secure_mass_runtime.hid_idle_rate = (uint8_t)(setup->wValue >> 8);
	return 0;
}

static int secure_hid_set_report(void *context, struct usb_setup_packet *setup,
				 int32_t *len, uint8_t **data)
{
	ARG_UNUSED(context);
	ARG_UNUSED(setup);

	if (*len > SECURE_HID_PKT_LEN) {
		return -EINVAL;
	}

	queue_hid_packet(*data, *len);
	return 0;
}

static int secure_hid_set_protocol(void *context,
				   struct usb_setup_packet *setup,
				   int32_t *len, uint8_t **data)
{
	ARG_UNUSED(context);
	ARG_UNUSED(len);
	ARG_UNUSED(data);

	secure_mass_runtime.hid_protocol = (uint8_t)setup->wValue;
	return 0;
}

static void secure_hid_int_in(uint8_t ep,
			      enum usb_dc_ep_cb_status_code ep_status)
{
	ARG_UNUSED(ep);

	if (ep_status == USB_DC_EP_DATA_IN) {
		atomic_clear_bit(secure_mass_runtime.hid_flags, HID_EP_BUSY_FLAG);
	}
}

static void secure_hid_int_out(uint8_t ep,
			       enum usb_dc_ep_cb_status_code ep_status)
{
	uint8_t buf[SECURE_HID_PKT_LEN];
	uint32_t bytes_read = 0U;

	if (ep_status != USB_DC_EP_DATA_OUT) {
		return;
	}

	if (usb_ep_read_wait(ep, buf, sizeof(buf), &bytes_read) == 0 &&
	    bytes_read > 0U) {
		queue_hid_packet(buf, bytes_read);
	}

	usb_ep_read_continue(ep);
}

void secure_hid_status_cb(struct usb_cfg_data *cfg,
			  enum usb_dc_status_code status,
			  const uint8_t *param)
{
	ARG_UNUSED(cfg);
	ARG_UNUSED(param);

	switch (status) {
	case USB_DC_RESET:
	case USB_DC_DISCONNECTED:
		secure_mass_runtime.hid_configured = false;
		atomic_clear_bit(secure_mass_runtime.hid_flags, HID_EP_BUSY_FLAG);
		break;
	case USB_DC_CONFIGURED:
		secure_mass_runtime.hid_configured = true;
		atomic_clear_bit(secure_mass_runtime.hid_flags, HID_EP_BUSY_FLAG);
		break;
	default:
		break;
	}
}

int secure_hid_class_handle_req(struct usb_setup_packet *setup,
				int32_t *len, uint8_t **data)
{
	return usb_hid_handle_class_request(0U, &secure_hid_req_handlers, NULL,
						 setup, len, data);
}

int secure_hid_custom_handle_req(struct usb_setup_packet *setup,
				 int32_t *len, uint8_t **data)
{
	return usb_hid_handle_descriptor_request(0U,
						 secure_mass_get_active_hid_descriptor(),
						 secure_hid_report_desc,
						 sizeof(secure_hid_report_desc),
						 setup, len, data);
}

void secure_hid_process_loop(void)
{
	while (true) {
		struct hid_rx_msg msg;

		k_msgq_get(&hid_rx_msgq, &msg, K_FOREVER);
		if (msg.len != sizeof(struct hid_pkt_v1)) {
			LOG_WRN("Ignoring HID packet of %u bytes", msg.len);
			continue;
		}

		handle_hid_request((const struct hid_pkt_v1 *)msg.data);
	}
}
```

## src/secure_mass_indicator.c
```c
/*
 * Copyright (c) 2026
 *
 * SPDX-License-Identifier: Apache-2.0
 */

#if defined(CONFIG_APP_SECURE_MASS_LOCK_STATUS_INDICATOR)

#include <zephyr/drivers/gpio.h>
#include <zephyr/logging/log.h>

#include "secure_mass_priv.h"

LOG_MODULE_DECLARE(secure_mass, LOG_LEVEL_INF);

static const struct gpio_dt_spec unlock_led =
	GPIO_DT_SPEC_GET_OR(DT_ALIAS(led0), gpios, {0});
static const struct gpio_dt_spec lock_led =
	GPIO_DT_SPEC_GET_OR(DT_ALIAS(led2), gpios, {0});

static int configure_indicator_led(const struct gpio_dt_spec *led)
{
	if (!led->port) {
		return 0;
	}

	if (!gpio_is_ready_dt(led)) {
		LOG_ERR("LED device %s is not ready", led->port->name);
		return -ENODEV;
	}

	return gpio_pin_configure_dt(led, GPIO_OUTPUT_INACTIVE);
}

static void set_indicator_led(const struct gpio_dt_spec *led, int value)
{
	if (!led->port) {
		return;
	}

	(void)gpio_pin_set_dt(led, value);
}

int secure_mass_indicator_init(void)
{
	int ret;

	ret = configure_indicator_led(&unlock_led);
	if (ret != 0) {
		return ret;
	}

	ret = configure_indicator_led(&lock_led);
	if (ret != 0) {
		return ret;
	}

	secure_mass_indicator_update(SECURE_STATE_LOCKED);
	return 0;
}

void secure_mass_indicator_update(enum secure_state state)
{
	switch (state) {
	case SECURE_STATE_UNLOCKED:
		set_indicator_led(&lock_led, 0);
		set_indicator_led(&unlock_led, 1);
		break;
	case SECURE_STATE_LOCKED:
		set_indicator_led(&unlock_led, 0);
		set_indicator_led(&lock_led, 1);
		break;
	default:
		break;
	}
}

#else

#include "secure_mass_priv.h"

int secure_mass_indicator_init(void)
{
	return 0;
}

void secure_mass_indicator_update(enum secure_state state)
{
	ARG_UNUSED(state);
}

#endif
```

## src/secure_mass_msc.c
```c
/*
 * Copyright (c) 2026
 *
 * SPDX-License-Identifier: Apache-2.0
 */

#include <zephyr/logging/log.h>

#include <zephyr/usb/class/msc_bot.h>
#include "secure_mass_priv.h"

LOG_MODULE_DECLARE(secure_mass, LOG_LEVEL_INF);

static const struct msc_bot_inquiry_data secure_msc_inquiry_rsp = {
	.head = { 0x00, 0x80, 0x00, 0x01, 36 - 4, 0x80, 0x00, 0x00 },
	.t10_vid = "Zephyr  ",
	.product_id = "Secure RAM Disk ",
	.revision = "1.00",
};

static struct msc_bot_ctx secure_msc_ctx;
static uint8_t __aligned(4)
	secure_msc_page[SECURE_MSC_BLOCK_SIZE + SECURE_MSC_EP_MPS];

K_KERNEL_STACK_DEFINE(secure_msc_thread_stack, SECURE_MSC_STACK_SIZE);

static void secure_msc_bulk_out(uint8_t ep,
				enum usb_dc_ep_cb_status_code ep_status);
static void secure_msc_bulk_in(uint8_t ep,
			       enum usb_dc_ep_cb_status_code ep_status);

static void secure_msc_on_eject(struct msc_bot_ctx *ctx, void *user_data)
{
	ARG_UNUSED(ctx);
	ARG_UNUSED(user_data);

	secure_mass_request_relock();
}

static const struct msc_bot_ops secure_msc_ops = {
	.on_eject = secure_msc_on_eject,
};

static const struct msc_bot_cfg secure_msc_cfg = {
	.disk_name = SECURE_RAMDISK_NAME,
	.in_ep_addr = SECURE_MSC_IN_EP_ADDR,
	.out_ep_addr = SECURE_MSC_OUT_EP_ADDR,
	.block_size = SECURE_MSC_BLOCK_SIZE,
	.packet_size = SECURE_MSC_EP_MPS,
	.inquiry = &secure_msc_inquiry_rsp,
	.medium_policy = MSC_BOT_MEDIUM_POLICY_TRACKED,
	.reset_on_disconnect = true,
	.default_sense_key = MSC_BOT_SCSI_SENSE_NONE,
	.default_sense_asc = 0x00,
	.default_sense_ascq = 0x00,
	.ops = &secure_msc_ops,
};

struct usb_ep_cfg_data secure_msc_ep_data[SECURE_MSC_NUM_ENDPOINTS] = {
	{
		.ep_cb = secure_msc_bulk_out,
		.ep_addr = SECURE_MSC_OUT_EP_ADDR,
	},
	{
		.ep_cb = secure_msc_bulk_in,
		.ep_addr = SECURE_MSC_IN_EP_ADDR,
	},
};

static void secure_msc_bulk_out(uint8_t ep,
				enum usb_dc_ep_cb_status_code ep_status)
{
	ARG_UNUSED(ep_status);

	msc_bot_bulk_out(&secure_msc_ctx, ep);
}

static void secure_msc_bulk_in(uint8_t ep,
			       enum usb_dc_ep_cb_status_code ep_status)
{
	ARG_UNUSED(ep);
	ARG_UNUSED(ep_status);

	msc_bot_bulk_in(&secure_msc_ctx);
}

void secure_msc_status_cb(struct usb_cfg_data *cfg,
			  enum usb_dc_status_code status,
			  const uint8_t *param)
{
	ARG_UNUSED(cfg);
	ARG_UNUSED(param);

	msc_bot_usb_status(&secure_msc_ctx, status);
}

int secure_msc_class_handle_req(struct usb_setup_packet *setup,
				int32_t *len, uint8_t **data)
{
	return msc_bot_class_handle_req(&secure_msc_ctx,
					secure_mass_get_active_msc_interface_number(),
					setup, len, data);
}

int secure_msc_init(void)
{
	int rc;

	rc = msc_bot_init(&secure_msc_ctx, &secure_msc_cfg, secure_msc_page,
			  sizeof(secure_msc_page));
	if (rc != 0) {
		LOG_ERR("secure MSC init failed (%d)", rc);
		return rc;
	}

	rc = msc_bot_start_thread(&secure_msc_ctx, secure_msc_thread_stack,
				  K_KERNEL_STACK_SIZEOF(secure_msc_thread_stack),
				  SECURE_MSC_THREAD_PRIO, "secure_msc");
	if (rc != 0) {
		LOG_ERR("secure MSC thread start failed (%d)", rc);
		return rc;
	}

	secure_msc_set_active(false);
	return 0;
}

void secure_msc_set_active(bool active)
{
	msc_bot_set_medium_state(&secure_msc_ctx, active, active);
	msc_bot_reset_protocol(&secure_msc_ctx);
}
```

## src/secure_mass_priv.h
```c
/*
 * Copyright (c) 2026
 *
 * SPDX-License-Identifier: Apache-2.0
 */

#ifndef ZEPHYR_SAMPLES_SUBSYS_USB_SECURE_MASS_PRIV_H_
#define ZEPHYR_SAMPLES_SUBSYS_USB_SECURE_MASS_PRIV_H_

#include <stdbool.h>
#include <stddef.h>
#include <stdint.h>

#include <zephyr/kernel.h>
#include <zephyr/logging/log.h>
#include <zephyr/sys/atomic.h>
#include <zephyr/sys/byteorder.h>
#include <zephyr/sys/util.h>
#include <zephyr/usb/class/usb_hid.h>
#include <zephyr/usb/usb_device.h>

#include <usb_descriptor.h>

#define SECURE_USB_MANUFACTURER		"Zephyr"
#define SECURE_USB_PRODUCT		"Secure USB Mass"
#define SECURE_USB_SN			"0011223344556677"

#define SECURE_PASSWORD_MAX_LEN		48
#define SECURE_HID_PKT_LEN		64
#define SECURE_HID_REPORT_DESC_SIZE	34

#define SECURE_HID_IN_EP_ADDR		0x81
#define SECURE_HID_OUT_EP_ADDR		0x01
#define SECURE_MSC_IN_EP_ADDR		0x82
#define SECURE_MSC_OUT_EP_ADDR		0x02

#define SECURE_HID_EP_MPS		64
#define SECURE_MSC_EP_MPS		64
#define SECURE_HID_INTERVAL_MS		10

#define SECURE_HID_NUM_ENDPOINTS	2
#define SECURE_MSC_NUM_ENDPOINTS	2

#define SECURE_MSC_BLOCK_SIZE		512
#define SECURE_MSC_THREAD_PRIO		-5
#define SECURE_MSC_STACK_SIZE		1536

#define SECURE_RAMDISK_NAME		"RAM"

#define SECURE_UNLOCK_DELAY_MS		300
#define SECURE_RELOCK_DELAY_MS		300
#define SECURE_DISCONNECT_DELAY_MS	10
#define SECURE_REENUM_DETACH_MS		1000

#define SECURE_BOOT_MODE_MAGIC		0x534d5355U

#define HID_EP_BUSY_FLAG		0

enum secure_cmd {
	SECURE_CMD_GET_INFO = 0x01,
	SECURE_CMD_UNLOCK = 0x02,
	SECURE_CMD_CHANGE_PASSWORD = 0x03,
};

enum secure_status {
	SECURE_STATUS_OK = 0x00,
	SECURE_STATUS_BAD_PASSWORD = 0x01,
	SECURE_STATUS_INVALID_STATE = 0x02,
	SECURE_STATUS_BAD_LENGTH = 0x03,
	SECURE_STATUS_BUSY = 0x04,
	SECURE_STATUS_NOT_SUPPORTED = 0x05,
	SECURE_STATUS_INTERNAL_ERROR = 0x06,
	SECURE_STATUS_PASSWORD_POLICY = 0x07,
};

enum secure_state {
	SECURE_STATE_LOCKED = 0,
	SECURE_STATE_UNLOCKED = 1,
	SECURE_STATE_TRANSITION = 2,
};

enum secure_usb_mode {
	SECURE_USB_MODE_LOCKED = 0,
	SECURE_USB_MODE_UNLOCKED = 1,
};

struct hid_pkt_v1 {
	uint8_t version;
	uint8_t cmd;
	uint8_t seq;
	uint8_t status;
	uint8_t len;
	uint8_t data[59];
} __packed;

BUILD_ASSERT(sizeof(struct hid_pkt_v1) == SECURE_HID_PKT_LEN,
	     "secure HID packet must stay 64 bytes");

struct hid_rx_msg {
	uint8_t len;
	uint8_t data[SECURE_HID_PKT_LEN];
};

struct secure_hid_interface_desc {
	struct usb_if_descriptor if0;
	struct usb_hid_descriptor if0_hid;
	struct usb_ep_descriptor if0_in_ep;
	struct usb_ep_descriptor if0_out_ep;
} __packed;

struct secure_msc_interface_desc {
	struct usb_if_descriptor if0;
	struct usb_ep_descriptor if0_in_ep;
	struct usb_ep_descriptor if0_out_ep;
} __packed;

#define DECLARE_ASCII_STRING_DESC(type_name, literal)				\
	struct type_name {							\
		uint8_t bLength;						\
		uint8_t bDescriptorType;					\
		uint8_t bString[USB_BSTRING_LENGTH(literal)];			\
	} __packed

DECLARE_ASCII_STRING_DESC(secure_mfr_str_desc, SECURE_USB_MANUFACTURER);
DECLARE_ASCII_STRING_DESC(secure_product_str_desc, SECURE_USB_PRODUCT);
DECLARE_ASCII_STRING_DESC(secure_sn_str_desc, SECURE_USB_SN);

struct secure_usb_strings {
	struct usb_string_descriptor lang_descr;
	struct secure_mfr_str_desc mfr;
	struct secure_product_str_desc product;
	struct secure_sn_str_desc sn;
} __packed;

struct secure_locked_descriptor_set {
	struct usb_device_descriptor dev;
	struct usb_cfg_descriptor cfg;
	struct secure_hid_interface_desc hid;
	struct secure_usb_strings strings;
	struct usb_desc_header term;
} __packed;

struct secure_unlocked_descriptor_set {
	struct usb_device_descriptor dev;
	struct usb_cfg_descriptor cfg;
	struct secure_hid_interface_desc hid;
	struct secure_msc_interface_desc msc;
	struct secure_usb_strings strings;
	struct usb_desc_header term;
} __packed;

struct secure_mass_runtime {
	enum secure_state state;
	enum secure_usb_mode usb_mode;
	enum secure_usb_mode pending_usb_mode;
	bool descriptors_ready;
	bool usb_switch_in_progress;
	bool hid_configured;
	bool unlocked_configured_once;
	uint8_t hid_idle_rate;
	uint8_t hid_protocol;
	atomic_t hid_flags[1];
	char current_password[SECURE_PASSWORD_MAX_LEN + 1];
	size_t current_password_len;
	struct k_work_delayable usb_switch_work;
};

extern struct secure_mass_runtime secure_mass_runtime;

extern struct usb_ep_cfg_data secure_hid_ep_data[SECURE_HID_NUM_ENDPOINTS];
extern struct usb_ep_cfg_data secure_msc_ep_data[SECURE_MSC_NUM_ENDPOINTS];

static inline bool secure_mass_is_transition_state(void)
{
	return secure_mass_runtime.state == SECURE_STATE_TRANSITION;
}

int secure_hid_class_handle_req(struct usb_setup_packet *setup,
				int32_t *len, uint8_t **data);
int secure_hid_custom_handle_req(struct usb_setup_packet *setup,
				 int32_t *len, uint8_t **data);
void secure_hid_status_cb(struct usb_cfg_data *cfg,
			  enum usb_dc_status_code status,
			  const uint8_t *param);
void secure_hid_process_loop(void);

int secure_msc_class_handle_req(struct usb_setup_packet *setup,
				int32_t *len, uint8_t **data);
void secure_msc_status_cb(struct usb_cfg_data *cfg,
			  enum usb_dc_status_code status,
			  const uint8_t *param);
int secure_msc_init(void);
void secure_msc_set_active(bool active);

int secure_mass_button_init(void);
int secure_mass_indicator_init(void);
void secure_mass_indicator_update(enum secure_state state);

int secure_mass_usb_init(void);
void secure_mass_schedule_mode_switch(enum secure_usb_mode mode,
				      k_timeout_t delay);
void secure_mass_request_relock(void);
int secure_mass_request_unlock(void);
const struct usb_hid_descriptor *secure_mass_get_active_hid_descriptor(void);
uint8_t secure_mass_get_active_msc_interface_number(void);

#endif /* ZEPHYR_SAMPLES_SUBSYS_USB_SECURE_MASS_PRIV_H_ */
```

## src/secure_mass_usb.c
```c
/*
 * Copyright (c) 2026
 *
 * SPDX-License-Identifier: Apache-2.0
 */

#include <zephyr/logging/log.h>

#if defined(CONFIG_APP_SECURE_MASS_REENUM_SOFT_REBOOT)
#include <zephyr/linker/section_tags.h>
#include <zephyr/sys/reboot.h>
#endif

#include "secure_mass_priv.h"

LOG_MODULE_DECLARE(secure_mass, LOG_LEVEL_INF);

#if defined(CONFIG_APP_SECURE_MASS_REENUM_SOFT_REBOOT)
struct secure_boot_mode_state {
	uint32_t magic;
	uint8_t next_mode;
	uint8_t reserved[3];
};

static __noinit struct secure_boot_mode_state secure_boot_mode_state;
#endif

struct secure_mass_runtime secure_mass_runtime = {
	.state = SECURE_STATE_LOCKED,
	.usb_mode = SECURE_USB_MODE_LOCKED,
	.pending_usb_mode = SECURE_USB_MODE_LOCKED,
	.hid_protocol = HID_PROTOCOL_REPORT,
	.current_password = "12345678",
	.current_password_len = 8U,
};

static struct secure_locked_descriptor_set locked_desc = {
	.dev = {
		.bLength = sizeof(struct usb_device_descriptor),
		.bDescriptorType = USB_DESC_DEVICE,
		.bcdUSB = sys_cpu_to_le16(USB_SRN_2_0),
		.bDeviceClass = 0,
		.bDeviceSubClass = 0,
		.bDeviceProtocol = 0,
		.bMaxPacketSize0 = USB_MAX_CTRL_MPS,
		.idVendor = sys_cpu_to_le16(CONFIG_USB_DEVICE_VID),
		.idProduct = sys_cpu_to_le16(CONFIG_USB_DEVICE_PID),
		.bcdDevice = sys_cpu_to_le16(USB_BCD_DRN),
		.iManufacturer = 1,
		.iProduct = 2,
		.iSerialNumber = 3,
		.bNumConfigurations = 1,
	},
	.cfg = {
		.bLength = sizeof(struct usb_cfg_descriptor),
		.bDescriptorType = USB_DESC_CONFIGURATION,
		.wTotalLength = sys_cpu_to_le16(sizeof(struct usb_cfg_descriptor) +
						sizeof(struct secure_hid_interface_desc)),
		.bNumInterfaces = 1,
		.bConfigurationValue = 1,
		.iConfiguration = 0,
		.bmAttributes = USB_SCD_RESERVED,
		.bMaxPower = CONFIG_USB_MAX_POWER,
	},
	.hid = {
		.if0 = {
			.bLength = sizeof(struct usb_if_descriptor),
			.bDescriptorType = USB_DESC_INTERFACE,
			.bInterfaceNumber = 0,
			.bAlternateSetting = 0,
			.bNumEndpoints = 2,
			.bInterfaceClass = USB_BCC_HID,
			.bInterfaceSubClass = 0,
			.bInterfaceProtocol = 0,
			.iInterface = 0,
		},
		.if0_hid = {
			.bLength = sizeof(struct usb_hid_descriptor),
			.bDescriptorType = USB_DESC_HID,
			.bcdHID = sys_cpu_to_le16(USB_HID_VERSION),
			.bCountryCode = 0,
			.bNumDescriptors = 1,
			.subdesc = {
				{
					.bDescriptorType = USB_DESC_HID_REPORT,
					.wDescriptorLength = 0,
				},
			},
		},
		.if0_in_ep = {
			.bLength = sizeof(struct usb_ep_descriptor),
			.bDescriptorType = USB_DESC_ENDPOINT,
			.bEndpointAddress = SECURE_HID_IN_EP_ADDR,
			.bmAttributes = USB_DC_EP_INTERRUPT,
			.wMaxPacketSize = sys_cpu_to_le16(SECURE_HID_EP_MPS),
			.bInterval = SECURE_HID_INTERVAL_MS,
		},
		.if0_out_ep = {
			.bLength = sizeof(struct usb_ep_descriptor),
			.bDescriptorType = USB_DESC_ENDPOINT,
			.bEndpointAddress = SECURE_HID_OUT_EP_ADDR,
			.bmAttributes = USB_DC_EP_INTERRUPT,
			.wMaxPacketSize = sys_cpu_to_le16(SECURE_HID_EP_MPS),
			.bInterval = SECURE_HID_INTERVAL_MS,
		},
	},
	.strings = {
		.lang_descr = {
			.bLength = sizeof(struct usb_string_descriptor),
			.bDescriptorType = USB_DESC_STRING,
			.bString = sys_cpu_to_le16(0x0409),
		},
		.mfr = {
			.bLength = USB_STRING_DESCRIPTOR_LENGTH(SECURE_USB_MANUFACTURER),
			.bDescriptorType = USB_DESC_STRING,
			.bString = SECURE_USB_MANUFACTURER,
		},
		.product = {
			.bLength = USB_STRING_DESCRIPTOR_LENGTH(SECURE_USB_PRODUCT),
			.bDescriptorType = USB_DESC_STRING,
			.bString = SECURE_USB_PRODUCT,
		},
		.sn = {
			.bLength = USB_STRING_DESCRIPTOR_LENGTH(SECURE_USB_SN),
			.bDescriptorType = USB_DESC_STRING,
			.bString = SECURE_USB_SN,
		},
	},
	.term = {
		.bLength = 0,
		.bDescriptorType = 0,
	},
};

static struct secure_unlocked_descriptor_set unlocked_desc = {
	.dev = {
		.bLength = sizeof(struct usb_device_descriptor),
		.bDescriptorType = USB_DESC_DEVICE,
		.bcdUSB = sys_cpu_to_le16(USB_SRN_2_0),
		.bDeviceClass = 0,
		.bDeviceSubClass = 0,
		.bDeviceProtocol = 0,
		.bMaxPacketSize0 = USB_MAX_CTRL_MPS,
		.idVendor = sys_cpu_to_le16(CONFIG_USB_DEVICE_VID),
		.idProduct = sys_cpu_to_le16(CONFIG_USB_DEVICE_PID),
		.bcdDevice = sys_cpu_to_le16(USB_BCD_DRN),
		.iManufacturer = 1,
		.iProduct = 2,
		.iSerialNumber = 3,
		.bNumConfigurations = 1,
	},
	.cfg = {
		.bLength = sizeof(struct usb_cfg_descriptor),
		.bDescriptorType = USB_DESC_CONFIGURATION,
		.wTotalLength = sys_cpu_to_le16(sizeof(struct usb_cfg_descriptor) +
						sizeof(struct secure_hid_interface_desc) +
						sizeof(struct secure_msc_interface_desc)),
		.bNumInterfaces = 2,
		.bConfigurationValue = 1,
		.iConfiguration = 0,
		.bmAttributes = USB_SCD_RESERVED,
		.bMaxPower = CONFIG_USB_MAX_POWER,
	},
	.hid = {
		.if0 = {
			.bLength = sizeof(struct usb_if_descriptor),
			.bDescriptorType = USB_DESC_INTERFACE,
			.bInterfaceNumber = 0,
			.bAlternateSetting = 0,
			.bNumEndpoints = 2,
			.bInterfaceClass = USB_BCC_HID,
			.bInterfaceSubClass = 0,
			.bInterfaceProtocol = 0,
			.iInterface = 0,
		},
		.if0_hid = {
			.bLength = sizeof(struct usb_hid_descriptor),
			.bDescriptorType = USB_DESC_HID,
			.bcdHID = sys_cpu_to_le16(USB_HID_VERSION),
			.bCountryCode = 0,
			.bNumDescriptors = 1,
			.subdesc = {
				{
					.bDescriptorType = USB_DESC_HID_REPORT,
					.wDescriptorLength = 0,
				},
			},
		},
		.if0_in_ep = {
			.bLength = sizeof(struct usb_ep_descriptor),
			.bDescriptorType = USB_DESC_ENDPOINT,
			.bEndpointAddress = SECURE_HID_IN_EP_ADDR,
			.bmAttributes = USB_DC_EP_INTERRUPT,
			.wMaxPacketSize = sys_cpu_to_le16(SECURE_HID_EP_MPS),
			.bInterval = SECURE_HID_INTERVAL_MS,
		},
		.if0_out_ep = {
			.bLength = sizeof(struct usb_ep_descriptor),
			.bDescriptorType = USB_DESC_ENDPOINT,
			.bEndpointAddress = SECURE_HID_OUT_EP_ADDR,
			.bmAttributes = USB_DC_EP_INTERRUPT,
			.wMaxPacketSize = sys_cpu_to_le16(SECURE_HID_EP_MPS),
			.bInterval = SECURE_HID_INTERVAL_MS,
		},
	},
		.msc = {
			.if0 = {
				.bLength = sizeof(struct usb_if_descriptor),
				.bDescriptorType = USB_DESC_INTERFACE,
				.bInterfaceNumber = 0,
				.bAlternateSetting = 0,
				.bNumEndpoints = 2,
				.bInterfaceClass = USB_BCC_MASS_STORAGE,
			.bInterfaceSubClass = 0x06,
			.bInterfaceProtocol = 0x50,
			.iInterface = 0,
		},
		.if0_in_ep = {
			.bLength = sizeof(struct usb_ep_descriptor),
			.bDescriptorType = USB_DESC_ENDPOINT,
			.bEndpointAddress = SECURE_MSC_IN_EP_ADDR,
			.bmAttributes = USB_DC_EP_BULK,
			.wMaxPacketSize = sys_cpu_to_le16(SECURE_MSC_EP_MPS),
			.bInterval = 0,
		},
		.if0_out_ep = {
			.bLength = sizeof(struct usb_ep_descriptor),
			.bDescriptorType = USB_DESC_ENDPOINT,
			.bEndpointAddress = SECURE_MSC_OUT_EP_ADDR,
			.bmAttributes = USB_DC_EP_BULK,
			.wMaxPacketSize = sys_cpu_to_le16(SECURE_MSC_EP_MPS),
			.bInterval = 0,
		},
	},
	.strings = {
		.lang_descr = {
			.bLength = sizeof(struct usb_string_descriptor),
			.bDescriptorType = USB_DESC_STRING,
			.bString = sys_cpu_to_le16(0x0409),
		},
		.mfr = {
			.bLength = USB_STRING_DESCRIPTOR_LENGTH(SECURE_USB_MANUFACTURER),
			.bDescriptorType = USB_DESC_STRING,
			.bString = SECURE_USB_MANUFACTURER,
		},
		.product = {
			.bLength = USB_STRING_DESCRIPTOR_LENGTH(SECURE_USB_PRODUCT),
			.bDescriptorType = USB_DESC_STRING,
			.bString = SECURE_USB_PRODUCT,
		},
		.sn = {
			.bLength = USB_STRING_DESCRIPTOR_LENGTH(SECURE_USB_SN),
			.bDescriptorType = USB_DESC_STRING,
			.bString = SECURE_USB_SN,
		},
	},
	.term = {
		.bLength = 0,
		.bDescriptorType = 0,
	},
};

static void secure_hid_interface_config(struct usb_desc_header *head,
					uint8_t bInterfaceNumber)
{
	struct usb_if_descriptor *if_desc = (struct usb_if_descriptor *)head;
	struct secure_hid_interface_desc *desc =
		CONTAINER_OF(if_desc, struct secure_hid_interface_desc, if0);

	desc->if0.bInterfaceNumber = bInterfaceNumber;
	usb_hid_set_report_size(&desc->if0_hid, SECURE_HID_REPORT_DESC_SIZE);
}

static void secure_msc_interface_config(struct usb_desc_header *head,
					uint8_t bInterfaceNumber)
{
	struct usb_if_descriptor *if_desc = (struct usb_if_descriptor *)head;
	struct secure_msc_interface_desc *desc =
		CONTAINER_OF(if_desc, struct secure_msc_interface_desc, if0);

	desc->if0.bInterfaceNumber = bInterfaceNumber;
}

USBD_DEFINE_CFG_DATA(secure_hid_config) = {
	.usb_device_description = NULL,
	.interface_config = secure_hid_interface_config,
	.interface_descriptor = NULL,
	.cb_usb_status = secure_hid_status_cb,
	.interface = {
		.class_handler = secure_hid_class_handle_req,
		.custom_handler = secure_hid_custom_handle_req,
	},
	.num_endpoints = SECURE_HID_NUM_ENDPOINTS,
	.endpoint = secure_hid_ep_data,
};

USBD_DEFINE_CFG_DATA(secure_msc_config) = {
	.usb_device_description = NULL,
	.interface_config = secure_msc_interface_config,
	.interface_descriptor = NULL,
	.cb_usb_status = secure_msc_status_cb,
	.interface = {
		.class_handler = secure_msc_class_handle_req,
		.custom_handler = NULL,
	},
	.num_endpoints = SECURE_MSC_NUM_ENDPOINTS,
	.endpoint = secure_msc_ep_data,
};

static void set_cfg_data_descriptors_for_mode(enum secure_usb_mode mode)
{
	if (mode == SECURE_USB_MODE_LOCKED) {
		secure_hid_config.interface_descriptor = &locked_desc.hid.if0;
		secure_msc_config.interface_descriptor = NULL;
	} else {
		secure_hid_config.interface_descriptor = &unlocked_desc.hid.if0;
		secure_msc_config.interface_descriptor = &unlocked_desc.msc.if0;
	}
}

static int prepare_descriptors_once(void)
{
	int ret;

	if (secure_mass_runtime.descriptors_ready) {
		return 0;
	}

	set_cfg_data_descriptors_for_mode(SECURE_USB_MODE_LOCKED);
	ret = usb_fix_descriptor((const uint8_t *)&locked_desc);
	if (ret != 0) {
		return ret;
	}

	set_cfg_data_descriptors_for_mode(SECURE_USB_MODE_UNLOCKED);
	ret = usb_fix_descriptor((const uint8_t *)&unlocked_desc);
	if (ret != 0) {
		return ret;
	}

	secure_mass_runtime.descriptors_ready = true;
	return 0;
}

#if defined(CONFIG_APP_SECURE_MASS_REENUM_SOFT_REBOOT)
static enum secure_usb_mode secure_mass_load_boot_mode(void)
{
	enum secure_usb_mode mode = SECURE_USB_MODE_LOCKED;

	if (secure_boot_mode_state.magic == SECURE_BOOT_MODE_MAGIC &&
	    secure_boot_mode_state.next_mode <= SECURE_USB_MODE_UNLOCKED) {
		mode = (enum secure_usb_mode)secure_boot_mode_state.next_mode;
	}

	secure_boot_mode_state.magic = 0U;
	secure_boot_mode_state.next_mode = SECURE_USB_MODE_LOCKED;

	return mode;
}

static void secure_mass_store_boot_mode(enum secure_usb_mode mode)
{
	secure_boot_mode_state.magic = SECURE_BOOT_MODE_MAGIC;
	secure_boot_mode_state.next_mode = (uint8_t)mode;
}
#endif

static const uint8_t *get_active_descriptor(enum secure_usb_mode mode)
{
	if (mode == SECURE_USB_MODE_LOCKED) {
		return (const uint8_t *)&locked_desc;
	}

	return (const uint8_t *)&unlocked_desc;
}

static void configure_cfg_data_for_mode(enum secure_usb_mode mode)
{
	set_cfg_data_descriptors_for_mode(mode);

	if (mode == SECURE_USB_MODE_LOCKED) {
		secure_msc_set_active(false);
	} else {
		secure_msc_set_active(true);
	}
}

const struct usb_hid_descriptor *secure_mass_get_active_hid_descriptor(void)
{
	if (secure_mass_runtime.usb_mode == SECURE_USB_MODE_LOCKED) {
		return &locked_desc.hid.if0_hid;
	}

	return &unlocked_desc.hid.if0_hid;
}

uint8_t secure_mass_get_active_msc_interface_number(void)
{
	return unlocked_desc.msc.if0.bInterfaceNumber;
}

static void secure_mass_set_runtime_mode(enum secure_usb_mode mode)
{
	secure_mass_runtime.usb_mode = mode;
	secure_mass_runtime.pending_usb_mode = mode;
	secure_mass_runtime.unlocked_configured_once = false;
	secure_mass_runtime.state = (mode == SECURE_USB_MODE_LOCKED) ?
		SECURE_STATE_LOCKED : SECURE_STATE_UNLOCKED;
	secure_mass_runtime.usb_switch_in_progress = false;
	secure_mass_indicator_update(secure_mass_runtime.state);
}

static void secure_usb_status_cb(enum usb_dc_status_code status,
				 const uint8_t *param)
{
	ARG_UNUSED(param);

	if (secure_mass_runtime.usb_switch_in_progress) {
		return;
	}

	if (secure_mass_runtime.usb_mode != SECURE_USB_MODE_UNLOCKED) {
		return;
	}

	switch (status) {
	case USB_DC_CONFIGURED:
		secure_mass_runtime.unlocked_configured_once = true;
		break;
	case USB_DC_DISCONNECTED:
		if (secure_mass_runtime.unlocked_configured_once) {
			secure_mass_runtime.unlocked_configured_once = false;
			secure_mass_schedule_mode_switch(SECURE_USB_MODE_LOCKED,
							 K_MSEC(SECURE_DISCONNECT_DELAY_MS));
		}
		break;
	default:
		break;
	}
}

static int enable_usb_mode(enum secure_usb_mode mode)
{
	int ret;

	configure_cfg_data_for_mode(mode);

	ret = usb_set_config(get_active_descriptor(mode));
	if (ret != 0) {
		LOG_ERR("usb_set_config failed (%d)", ret);
		return ret;
	}

	ret = usb_enable(secure_usb_status_cb);
	if (ret != 0) {
		LOG_ERR("usb_enable failed (%d)", ret);
		return ret;
	}

	secure_mass_set_runtime_mode(mode);

	LOG_INF("USB mode is now %s",
		mode == SECURE_USB_MODE_LOCKED ? "locked (HID)" :
		"unlocked (HID + MSC)");

	return 0;
}

#if defined(CONFIG_APP_SECURE_MASS_REENUM_USB_DISABLE_ENABLE)
static int reenumerate_usb_mode(enum secure_usb_mode mode)
{
	int ret;

	ret = usb_disable();
	if (ret != 0) {
		LOG_WRN("usb_disable returned %d", ret);
	}

	k_sleep(K_MSEC(SECURE_REENUM_DETACH_MS));
	usb_deconfig();

	return enable_usb_mode(mode);
}
#endif

static void usb_switch_work_handler(struct k_work *work)
{
	ARG_UNUSED(work);

	secure_mass_runtime.usb_switch_in_progress = true;

#if defined(CONFIG_APP_SECURE_MASS_REENUM_SOFT_REBOOT)
	secure_mass_store_boot_mode(secure_mass_runtime.pending_usb_mode);

	LOG_INF("Rebooting into %s mode",
		secure_mass_runtime.pending_usb_mode == SECURE_USB_MODE_LOCKED ?
		"locked" : "unlocked");

	sys_reboot(SYS_REBOOT_WARM);
#else
	if (reenumerate_usb_mode(secure_mass_runtime.pending_usb_mode) != 0) {
		secure_mass_runtime.state =
			(secure_mass_runtime.usb_mode == SECURE_USB_MODE_LOCKED) ?
			SECURE_STATE_LOCKED : SECURE_STATE_UNLOCKED;
		secure_mass_runtime.pending_usb_mode = secure_mass_runtime.usb_mode;
		secure_mass_runtime.usb_switch_in_progress = false;
	}
#endif
}

void secure_mass_schedule_mode_switch(enum secure_usb_mode mode,
				      k_timeout_t delay)
{
	secure_mass_runtime.pending_usb_mode = mode;
	secure_mass_runtime.state = SECURE_STATE_TRANSITION;
	k_work_reschedule(&secure_mass_runtime.usb_switch_work, delay);
}

void secure_mass_request_relock(void)
{
	if (secure_mass_runtime.state == SECURE_STATE_UNLOCKED &&
	    !secure_mass_runtime.usb_switch_in_progress) {
		secure_mass_schedule_mode_switch(SECURE_USB_MODE_LOCKED,
						 K_MSEC(SECURE_RELOCK_DELAY_MS));
	}
}

int secure_mass_request_unlock(void)
{
	if (secure_mass_runtime.usb_switch_in_progress ||
	    secure_mass_is_transition_state()) {
		return -EBUSY;
	}

	if (secure_mass_runtime.state != SECURE_STATE_LOCKED) {
		return -EALREADY;
	}

	secure_mass_schedule_mode_switch(SECURE_USB_MODE_UNLOCKED,
					 K_MSEC(SECURE_UNLOCK_DELAY_MS));
	return 0;
}

int secure_mass_usb_init(void)
{
	int ret;
	enum secure_usb_mode boot_mode;

	k_work_init_delayable(&secure_mass_runtime.usb_switch_work,
			      usb_switch_work_handler);
	ret = prepare_descriptors_once();
	if (ret != 0) {
		LOG_ERR("Descriptor preparation failed (%d)", ret);
		return ret;
	}

#if defined(CONFIG_APP_SECURE_MASS_REENUM_SOFT_REBOOT)
	boot_mode = secure_mass_load_boot_mode();
#else
	boot_mode = SECURE_USB_MODE_LOCKED;
#endif

	ret = enable_usb_mode(boot_mode);
	if (ret != 0) {
		LOG_ERR("Initial USB enable failed (%d)", ret);
		return ret;
	}

	return 0;
}
```
